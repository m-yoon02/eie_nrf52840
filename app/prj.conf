## prj.conf
```kconfig
# Copyright (c) 2021 Nordic Semiconductor ASA
# SPDX-License-Identifier: Apache-2.0
#
# This file contains selected Kconfig options for the application.

CONFIG_SYSTEM_WORKQUEUE_STACK_SIZE=2048
CONFIG_BT=y
CONFIG_BT_PERIPHERAL=y
CONFIG_BT_DEVICE_NAME="9382 EiE BLE Peripheral"
```

## src/main.c
```c
/**
 * @file main.c
 */

#include <inttypes.h>

#include <zephyr/kernel.h>
#include <zephyr/sys/printk.h>

#include "BTN.h"
#include "LED.h"
#include "stdio.h"

#define SLEEP_MS 1

int main(void) {
  if (0 > BTN_init()) {
    return 0;
  }
    
  if (0 > LED_init()) {
    return 0;
  }



  while(1) {
    if (BTN_check_clear_pressed(BTN0)) {
      LED_toggle(LED0);
      printk("Button 0 pressed\n");
      
    }

    k_msleep(SLEEP_MS);
  }

  
  return 0;
}
```
